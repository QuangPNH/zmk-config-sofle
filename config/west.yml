## config/west.yml
```yaml
manifest:
  remotes:
    - name: zmkfirmware
      url-base: https://github.com/zmkfirmware
    - name: infused-kim
      url-base: https://github.com/infused-kim
    - name: petejohnson
      url-base: https://github.com/petejohanson
  projects:
    - name: zmk
      remote: petejohnson
      import: app/west.yml
  self:
    path: config
```
